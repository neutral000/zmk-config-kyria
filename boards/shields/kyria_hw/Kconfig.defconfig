## boards/shields/kyria_hw/Kconfig.defconfig
```kconfig
if SHIELD_KYRIA_HW_LEFT

config ZMK_KEYBOARD_NAME
    default "Kyria"

config ZMK_SPLIT_ROLE_CENTRAL
    default y

endif

if SHIELD_KYRIA_HW_LEFT || SHIELD_KYRIA_HW_RIGHT

config ZMK_SPLIT
    default y
config ZMK_BLE
    default n

endif
```

## boards/shields/kyria_hw/Kconfig.shield
```kconfig
config SHIELD_KYRIA_HW_LEFT
    def_bool $(shields_list_contains,kyria_hw_left)

config SHIELD_KYRIA_HW_RIGHT
    def_bool $(shields_list_contains,kyria_hw_right)
```

## shields/kyria/Kconfig.shield
```kconfig
config SHIELD_KYRIA_LEFT
    def_bool $(shields_list_contains,kyria_left)

config SHIELD_KYRIA_RIGHT
    def_bool $(shields_list_contains,kyria_right)
```
